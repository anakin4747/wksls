## tests/fixtures/diagnostics_valid.wks
```
part / --source rootfs --ondisk sda --fstype=ext4 --align 1024
bootloader --ptable gpt --timeout=5
```

## tests/fixtures/hover_source_plugins.wks
```
part / --source rootfs
part / --source bootimg_efi
part / --source bootimg_partition
part / --source bootimg_pcbios
part / --source bootimg_biosplusefi
part / --source empty
part / --source extra_partition
part / --source isoimage_isohybrid
part / --source rawcopy
```

## tests/fixtures/hover_source_plugins_dash.wks
```
part / --source bootimg-efi
part / --source bootimg-partition
part / --source bootimg-pcbios
part / --source bootimg-biosplusefi
part / --source extra-partition
part / --source isoimage-isohybrid
```

## tests/oe-fixture/scripts/lib/wic/canned-wks/wksls-biosplusefi.wks
```
part /boot --source bootimg_biosplusefi --ondisk sda --label boot --active --align 1024
```

## tests/oe-fixture/scripts/lib/wic/canned-wks/wksls-bootimg-efi-dash.wks
```
part /boot --source bootimg-efi --ondisk sda --label msdos --active --align 1024
```
